## subsys/usb/device_next/class/Kconfig.gs_usb
```kconfig
# SPDX-FileCopyrightText: Copyright (c) 2022-2026 Henrik Brix Andersen <henrik@brixandersen.dk>
#
# SPDX-License-Identifier: Apache-2.0

config USBD_GS_USB
	bool "Geschwister Schneider USB/CAN Device Class support"
	default y
	depends on DT_HAS_GS_USB_ENABLED
	select NET_BUF
	select CAN
	imply CAN_ACCEPT_RTR
	help
	  Geschwister Schneider USB/CAN (gs_usb) device class support.

if USBD_GS_USB

module = USBD_GS_USB
module-str = gs_usb
source "subsys/logging/Kconfig.template.log_config"

config USBD_GS_USB_MAX_CHANNELS
	int "Maximum number of supported channels"
	default 1
	range 1 256
	help
	  Maximum number of supported Geschwister Schneider USB/CAN (gs_usb) channels. Each channel
	  represents one CAN controller.

config USBD_GS_USB_POOL_SIZE
	int "Host frame buffer pool size"
	default 20 if !USBD_GS_USB_COMPATIBILITY_MODE
	default 21 if USBD_GS_USB_COMPATIBILITY_MODE
	help
	  Size of the pool used for allocating Geschwister Schneider USB/CAN (gs_usb) host
	  frames. The pool is used for both RX and TX, and shared between all channels of a given
	  gs_usb instance.

config USBD_GS_USB_TX_NONBLOCKING
	bool "Do not block TX on a stalled channel, report dropped frames as error frames"
	help
	  By default, the shared TX thread waits indefinitely for a free CAN controller TX
	  mailbox. If a channel cannot transmit (e.g. no ACK on the CAN bus), this blocks TX on
	  all channels.

	  When enabled, the TX thread waits at most USBD_GS_USB_TX_TIMEOUT_MS for a free TX
	  mailbox and then drops the frame. A CAN_ERR_TX_TIMEOUT error frame is sent to the host
	  for each dropped frame. No echo frame is sent for a dropped frame, so the host does not
	  see it as transmitted. As a consequence, the host TX contexts of dropped frames stay in
	  use: once all of them are used, the host reports ENOBUFS for this channel only, and the
	  channel needs to be brought down and up again on the host after the bus problem has
	  been resolved. Other channels are not affected.

config USBD_GS_USB_TX_DROP_ECHO
	bool "Echo dropped frames to the host"
	depends on USBD_GS_USB_TX_NONBLOCKING
	help
	  Also send the echo frame for a dropped frame. This releases the host TX context, so
	  the channel recovers by itself once the bus problem has been resolved. Note that the
	  host driver counts the echo frame as a successfully transmitted frame.

config USBD_GS_USB_TX_TIMEOUT_MS
	int "Timeout for enqueuing a CAN frame for TX"
	depends on USBD_GS_USB_TX_NONBLOCKING
	default 20
	range 0 1000
	help
	  Maximum time in milliseconds the shared TX thread waits for a free CAN controller TX
	  mailbox before dropping the frame. This prevents a channel without bus ACKs from
	  blocking TX on all other channels.

config USBD_GS_USB_IDENTIFICATION
	bool "Enable support for CAN channel identification"
	help
	  Enable support for CAN channel identification callback provided by the application.

config USBD_GS_USB_TIMESTAMP
	bool "Enable support for hardware timestamps"
	help
	  Enable support for hardware timestamps provided by the application.

config USBD_GS_USB_TIMESTAMP_SOF
	bool "Capture hardware timestamp on USB SoF"
	depends on USBD_GS_USB_TIMESTAMP
	select UDC_ENABLE_SOF
	help
	  Capture the hardware timestamp on each USB Start of Frame event. This improves the
	  timestamp accurracy with the cost of a higher CPU load.

config USBD_GS_USB_TERMINATION
	bool "Enable support for CAN bus termination resistors"
	help
	  Enable support for software-controlled CAN termination resistors.

config USBD_GS_USB_RX_THREAD_STACK_SIZE
	int "Stack size for the RX thread"
	default 1024
	help
	  Size of the stack used for the internal RX thread.

config USBD_GS_USB_RX_THREAD_PRIO
	int "Priority for the RX thread"
	default 0
	help
	  Priority level for the internal RX thread.

config USBD_GS_USB_TX_THREAD_STACK_SIZE
	int "Stack size for the TX thread"
	default 1024
	help
	  Size of the stack used for the internal TX thread.

config USBD_GS_USB_TX_THREAD_PRIO
	int "Priority for the TX thread"
	default 0
	help
	  Priority level for the internal TX thread.

config USBD_GS_USB_COMPATIBILITY_MODE
	bool "Enable compatibility mode"
	default y
	help
	  Enable Geschwister Schneider USB/CAN (gs_usb) driver compatibility mode.

	  The Linux kernel gs_usb driver prior to kernel v6.12.5 uses hardcoded USB endpoint
	  addresses 0x81 (bulk IN) and 0x02 (bulk OUT). The same assumption on USB endpoint
	  addresses may be present in other drivers as well (e.g. python-can).

	  Depending on the capabilities of the USB device controller, the requested USB endpoint
	  addresses may be rewritten by the Zephyr USB device stack at runtime. Enabling
	  compatibility mode will include a second bulk OUT endpoint to ensure correct operation
	  with gs_usb drivers using the hardcoded USB endpoint addresses described above.

	  It is safe to enable compatibility mode regardless of the driver being used, but the
	  resulting firmware will require slightly more RAM and flash resources.

endif # USBD_GS_USB
```
